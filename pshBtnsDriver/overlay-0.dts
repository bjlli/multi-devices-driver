/dts-v1/;
/plugin/;
/{
	compatible = "allwinner,sun8i-h3";
	fragment@0 {
		target-path = "/";
		__overlay__{
			my_device_0{
				dev_num = <0>;
				compatible = "emc-logic, pshBtns";
				status = "okay";
				pBtn_label = "rpi-gpio-12";
				pBtn_gpio = <12>;
			};
		};
	};
};
