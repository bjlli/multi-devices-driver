/dts-v1/;
/plugin/;
/{
        compatible = "allwinner,sun8i-h3";
        fragment@0 {
                target-path = "/";
                __overlay__{
                        my_device_0{
                                dev_num = <0>;
                                compatible = "emc-logic, pshBtns";
                                status = "okay";
                                sens_label = "rpi-gpio-11";
                                sens_gpio = <11>;
                        };
                };
        };
};
